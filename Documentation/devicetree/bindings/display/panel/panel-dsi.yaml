## Documentation/devicetree/bindings/display/panel/panel-dsi.yaml
```yaml
# SPDX-License-Identifier: (GPL-2.0-only OR BSD-2-Clause)
%YAML 1.2
---
$id: http://devicetree.org/schemas/display/panel/panel-dsi.yaml#
$schema: http://devicetree.org/meta-schemas/core.yaml#

title: Generic MIPI DSI Panel

maintainers:
  - Timon Skerutsch <timon@diodes-delight.com>

allOf:
  - $ref: panel-common.yaml#

properties:
  compatible:
    description:
      Shall contain a panel specific compatible and "panel-dsi"
      in that order.
    items:
      - {}
      - const: panel-dsi

  dsi-color-format:
    description: |
      The color format used by the panel. Only DSI supported formats are allowed.
    enum:
      - RGB888
      - RGB666
      - RGB666_PACKED
      - RGB565

  lanes:
    description: |
      The number of lanes used by the panel.
    $ref: /schemas/types.yaml#/definitions/uint32
    enum: [1, 2, 3, 4]

  mode:
    description: |
      DSI mode flags. See DSI Specs for details.
      These are driver independent features of the DSI bus.
    items:
      - const: MODE_VIDEO
      - const: MODE_VIDEO_BURST
      - const: MODE_VIDEO_SYNC_PULSE
      - const: MODE_VIDEO_AUTO_VERT
      - const: MODE_VIDEO_HSE
      - const: MODE_VIDEO_NO_HFP
      - const: MODE_VIDEO_NO_HBP
      - const: MODE_VIDEO_NO_HSA
      - const: MODE_VSYNC_FLUSH
      - const: MODE_NO_EOT_PACKET
      - const: CLOCK_NON_CONTINUOUS
      - const: MODE_LPM
      - const: HS_PKT_END_ALIGNED

  backlight: true
  enable-gpios: true
  width-mm: true
  height-mm: true
  label: true
  panel-timing: true
  port: true
  power-supply: true
  reset-gpios: true
  ddc-i2c-bus: true

required:
  - panel-timing
  - power-supply
  - dsi-color-format
  - lanes

additionalProperties: false

examples:
  - |
    panel {
        compatible = "panel-mfgr,generic-dsi-panel","panel-dsi";
        label = "Simple DSI Panel";
        power-supply = <&vcc_supply>;
        backlight = <&backlight>;
        dsi-color-format = "RGB888";
        lanes = <1>;
        mode = "MODE_VIDEO", "MODE_VIDEO_BURST", "MODE_NO_EOT_PACKET";

        port {
            panel_dsi_port: endpoint {
                remote-endpoint = <&dsi_out>;
            };
        };
        panel-timing {
            clock-frequency = <9200000>;
            hactive = <800>;
            vactive = <480>;
            hfront-porch = <8>;
            hback-porch = <4>;
            hsync-len = <41>;
            vback-porch = <2>;
            vfront-porch = <4>;
            vsync-len = <10>;

            hsync-active = <0>;
            vsync-active = <0>;
            de-active = <1>;
            pixelclk-active = <1>;
        };
    };

...
```

## Documentation/devicetree/bindings/input/touchscreen/ti,tsc2007.yaml
```yaml
# SPDX-License-Identifier: (GPL-2.0-only OR BSD-2-Clause)
%YAML 1.2
---
$id: http://devicetree.org/schemas/input/touchscreen/ti,tsc2007.yaml#
$schema: http://devicetree.org/meta-schemas/core.yaml#

title: Texas Instruments TSC2007 touchscreen controller bindings

maintainers:
  - Timon Skerutsch <kernel@diodes-delight.com>

allOf:
  - $ref: touchscreen.yaml#

properties:
  compatible:
    enum:
      - ti,tsc2007

  reg:
    maxItems: 1
    description: |
      I2C address of the chip.

  interrupts:
    maxItems: 1
    description: |
      (gpio) interrupt to which the chip is connected

  gpios:
    maxItems: 1
    description: the interrupt gpio the chip is connected to (trough the penirq pin).

  ti,poll-period: how much time to wait (in milliseconds) before reading again

  # the following parameters are legacy properties and should be avoided
  # for new applications, use the generic touchscreen bindings below instead
  ti,x-plate-ohms: X-plate resistance in ohms.
  ti,max-rt: maximum pressure.
  ti,fuzzx: specifies the absolute input fuzz x value.
  If set, it will permit noise in the data up to +- the value given to the fuzz
  parameter, that is used to filter noise from the event stream.
  ti,fuzzy: specifies the absolute input fuzz y value.
  ti,fuzzz: specifies the absolute input fuzz z value.
  ti,poll-period: how much time to wait (in milliseconds) before reading again the
  values from the tsc2007.

  touchscreen-fuzz-pressure: true
  touchscreen-fuzz-x: true
  touchscreen-fuzz-y: true
  touchscreen-min-pressure: true
  touchscreen-max-pressure: true
  touchscreen-min-x: true
  touchscreen-size-x: true
  touchscreen-min-y: true
  touchscreen-size-y: true
  touchscreen-x-plate-ohms: true
  touchscreen-inverted-x: true
  touchscreen-inverted-y: true
  touchscreen-swapped-x-y: true


additionalProperties: false

required:
  - compatible
  - reg

examples:
  - |
    tsc2007@48 {
        compatible = "ti,tsc2007";
        reg = <0x48>;
        touchscreen-swapped-x-y;
        touchscreen-inverted-x;
        touchscreen-min-x = <350>;
        touchscreen-size-x = <3700>;
        touchscreen-fuzz-x = <4>;
        touchscreen-min-y = <320>;
        touchscreen-size-y = <3700>;
        touchscreen-fuzz-y = <4>;
        touchscreen-min-pressure = <1000>;
        touchscreen-max-pressure = <3700>;
        touchscreen-fuzz-pressure = <4>;
        touchscreen-x-plate-ohms = <180>;

        pinctrl-0 = <&tsc_int_pin>;
        interrupt-parent = <&gpio>;
        interrupts = <17 2>;
        gpios = <&gpio 17 1>;

    };
```
